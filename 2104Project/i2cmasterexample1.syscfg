// These arguments were used when this file was generated. They will be automatically applied on subsequent loads 
// via the GUI or CLI invocations. Run CLI with '--help' for additional information on how to override these arguments.
// @cliArgs --board "/ti/boards/MSP_EXP432P401R" --product "simplelink_msp432p4_sdk@3.30.00.13"
// @versions {"data":"2019051709","timestamp":"2019051709","tool":"1.1.792","templates":"2019051709"}

var RTOS = scripting.addModule("/ti/drivers/RTOS");
var I2C = scripting.addModule("/ti/drivers/I2C");
var I2C1 = I2C.addInstance();
var GPIO = scripting.addModule("/ti/drivers/GPIO");
var UART = scripting.addModule("/ti/drivers/UART");
var UART1 = UART.addInstance();
var PWM = scripting.addModule("/ti/drivers/PWM");
var PWM1 = PWM.addInstance();
var Timer = scripting.addModule("/ti/drivers/Timer");
var Timer1 = Timer.addInstance();
var Button = scripting.addModule("/ti/drivers/apps/Button");
var Button1 = Button.addInstance();
var I2C2 = I2C.addInstance();
var GPIO1 = GPIO.addInstance();
var GPIO2 = GPIO.addInstance();
var GPIO3 = GPIO.addInstance();
var PWM2 = PWM.addInstance();
// Name
RTOS.timer0.resource.$name = "MyTIMER_A1";
// Name - The C/C++ identifier used in applications as the index parameter passed to I2C runtime APIs
I2C1.$name = "CONFIG_I2C_0";
// Name
I2C1.i2c.$name = "MyI2C1";
// Assign pin
I2C1.i2c.sdaPin.$assign = "boosterpack.10"; // P6.4
// Assign pin
I2C1.i2c.sclPin.$assign = "boosterpack.9"; // P6.5
var Power = scripting.addModule("/ti/drivers/Power");
// Name
Power.performanceLevel3.$name = "ti_drivers_power_PowerMSP432PerfLevels0";
// Name
Power.performanceLevel2.$name = "ti_drivers_power_PowerMSP432PerfLevels1";
// Name
Power.performanceLevel1.$name = "ti_drivers_power_PowerMSP432PerfLevels2";
// Name
Power.performanceLevel0.$name = "ti_drivers_power_PowerMSP432PerfLevels3";
var Board = scripting.addModule("/ti/drivers/Board");
var DriverLib = scripting.addModule("/ti/devices/DriverLib");
// Name - The C/C++ identifier used in applications as the index parameter passed to UART runtime APIs
UART1.$name = "CONFIG_UART_0";
// Use Hardware - Select the hardware to use, or 'none' to use available header pins
UART1.$hardware = system.deviceData.board.components.XDS110UART;
// Baud Rates - The set of baud rates that are used by this instance. On some devices, these rates are used to pre-compute a table of clock dividers necessary for each rate.
UART1.baudRates = [9600];
// Interrupt Priority - UART peripheral interrupt priority
UART1.interruptPriority = "1";
// Clock Source - Specifies the clock source for the UART peripheral
UART1.clockSource = "SMCLK";
// Name
UART1.uart.$name = "MyUART1";
// Name - The C/C++ identifier used in applications as the index parameter passed to PWM runtime APIs
PWM1.$name = "CONFIG_PWM_Motor";
// Name
PWM1.timer.$name = "MyTIMER_A1";
// Assign pin (ignoring conflicts)
PWM1.timer.pwmPin.$assignAllowConflicts = "boosterpack.19"; // P2.5
// Name - The C/C++ identifier used in applications as the index parameter passed to Timer runtime APIs
Timer1.$name = "CONFIG_TIMER_0";
// Timer Type
Timer1.timerType = "32 Bits";
// Interrupt Priority - Timer Interrupt Priority
Timer1.interruptPriority = "3";
// Name
Timer1.timer.$name = "MyTIMER321";
// Use Peripheral
Timer1.timer.$assign = "TIMER32_1";
// Name - The C/C++ identifier used in applications as the index parameter passed to Button runtime APIs
Button1.$name = "CONFIG_BUTTON_0";
// Use Hardware - Select the hardware to use, or 'none' to use available header pins
Button1.$hardware = system.deviceData.board.components.S1;
// Name - The C/C++ identifier used in applications as the index parameter passed to GPIO runtime APIs
Button1.gpioPin.$name = "CONFIG_GPIO_0";
// Pull - Specifies the internal pull-up or pull-down resistor configuration of this GPIO pin.
Button1.gpioPin.pull = "Pull Up";
// Interrupt Trigger - Specifies when or if interrupts are triggered
Button1.gpioPin.interruptTrigger = "Falling Edge";
// Name - The C/C++ identifier used in applications as the index parameter passed to I2C runtime APIs
I2C2.$name = "CONFIG_I2C_1";
// Name
I2C2.i2c.$name = "MyI2C1";
// Use Peripheral
I2C2.i2c.$assign = "EUSCI_B0";
// Assign pin
I2C2.i2c.sdaPin.$assign = "boosterpack.15"; // P1.6
// Assign pin
I2C2.i2c.sclPin.$assign = "boosterpack.14"; // P1.7
// Use Hardware - Select the hardware to use, or 'none' to use available header pins
GPIO1.$hardware = system.deviceData.board.components.LED2_RED;
// Pull - Specifies the internal pull-up or pull-down resistor configuration of this GPIO pin.
GPIO1.pull = "Pull Up";
// Name - The C/C++ identifier used in applications as the index parameter passed to GPIO runtime APIs
GPIO1.$name = "CONFIG_GPIO_RED";
// Use Hardware - Select the hardware to use, or 'none' to use available header pins
GPIO2.$hardware = system.deviceData.board.components.LED2_BLUE;
// Pull - Specifies the internal pull-up or pull-down resistor configuration of this GPIO pin.
GPIO2.pull = "Pull Up";
// Name - The C/C++ identifier used in applications as the index parameter passed to GPIO runtime APIs
GPIO2.$name = "CONFIG_GPIO_BLUE";
// Use Hardware - Select the hardware to use, or 'none' to use available header pins
GPIO3.$hardware = system.deviceData.board.components.LED1_RED;
// Pull - Specifies the internal pull-up or pull-down resistor configuration of this GPIO pin.
GPIO3.pull = "Pull Up";
// Name - The C/C++ identifier used in applications as the index parameter passed to GPIO runtime APIs
GPIO3.$name = "CONFIG_GPIO_RED_LEFT";
// Use Hardware - Select the hardware to use, or 'none' to use available header pins
PWM2.$hardware = system.deviceData.board.components.LED2_GREEN;
// Name - The C/C++ identifier used in applications as the index parameter passed to PWM runtime APIs
PWM2.$name = "CONFIG_PWM_Green";
// Name
PWM2.timer.$name = "MyTIMER_A1";
// Assign pin
PWM2.timer.pwmPin.$assign = "P2.1.GPIO/EUSCI_A1_SPI.CLK"; // pin number - 17
// Suggest solution
RTOS.timer0.resource.$suggestSolution = "Timer_A0";
// Suggest solution
I2C1.i2c.$suggestSolution = "EUSCI_B1";
// Suggest solution
UART1.uart.$suggestSolution = "EUSCI_A0";
// Suggest solution
UART1.uart.txPin.$suggestSolution = "7";
// Suggest solution
UART1.uart.rxPin.$suggestSolution = "6";
// Suggest solution
PWM1.timer.$suggestSolution = "Timer_A1";
// Suggest solution
Button1.gpioPin.gpioPin.$suggestSolution = "5";
// Suggest solution
GPIO1.gpioPin.$suggestSolution = "16";
// Suggest solution
GPIO2.gpioPin.$suggestSolution = "18";
// Suggest solution
GPIO3.gpioPin.$suggestSolution = "4";
// Suggest solution
PWM2.timer.$suggestSolution = "Timer_A1";
